## boards/shields/edge/Kconfig.defconfig
```kconfig
if SHIELD_EDGE_LEFT

config ZMK_KEYBOARD_NAME
    default "edge"

config ZMK_SPLIT_ROLE_CENTRAL
    default y

endif # SHIELD_EDGE_LEFT

if SHIELD_EDGE_LEFT || SHIELD_EDGE_RIGHT

config ZMK_SPLIT
    default y

endif # SHIELD_EDGE_LEFT || SHIELD_EDGE_RIGHT
```

## boards/shields/edge/Kconfig.shield
```kconfig
config SHIELD_EDGE_LEFT
    def_bool $(shields_list_contains,edge_left)

config SHIELD_EDGE_RIGHT
    def_bool $(shields_list_contains,edge_right)
```
